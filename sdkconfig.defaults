## sdkconfig.defaults
```kconfig
CONFIG_FREERTOS_USE_TRACE_FACILITY=y
CONFIG_FREERTOS_GENERATE_RUN_TIME_STATS=y
CONFIG_FREERTOS_RUN_TIME_COUNTER_TYPE_U64=y
CONFIG_ESP_HTTP_CLIENT=y
CONFIG_MBEDTLS_C=y
CONFIG_ESP32_BROWNOUT_DET=n
CONFIG_BROWNOUT_DET=n

CONFIG_ESPTOOLPY_FLASHSIZE_4MB=y
CONFIG_ESPTOOLPY_FLASHSIZE="4MB"
```
